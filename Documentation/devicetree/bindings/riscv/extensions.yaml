## Documentation/devicetree/bindings/riscv/riscv,cbqri.yaml
```yaml
# SPDX-License-Identifier: GPL-2.0-only OR BSD-2-Clause
%YAML 1.2
---
$id: http://devicetree.org/schemas/riscv/riscv,cbqri.yaml#
$schema: http://devicetree.org/meta-schemas/core.yaml#

title: RISC-V Capacity and Bandwidth QoS Register Interface (CBQRI) controller

description: |
  The RISC-V CBQRI specification defines capacity-controller and
  bandwidth-controller register blocks that allocate cache capacity and memory
  bandwidth to resource-control IDs (RCIDs) and monitor usage per
  monitoring-counter ID (MCID):
  https://github.com/riscv-non-isa/riscv-cbqri/blob/main/riscv-cbqri.pdf

  Allocation and monitoring share one register block, and a controller may
  implement either or both. A driver discovers which at runtime from the
  capabilities register, so the compatible names only the controller type. It
  does not distinguish allocation-only, monitoring-only or combined
  controllers, and no property declares monitoring support.

maintainers:
  - Drew Fustini <fustini@kernel.org>

properties:
  compatible:
    oneOf:
      - items:
          - enum:
              - tenstorrent,ascalon-shared-cache-controller
          - const: riscv,cbqri-capacity-controller
      - items:
          - {}
          - const: riscv,cbqri-bandwidth-controller

  reg:
    maxItems: 1
    description:
      The CBQRI controller register block.

  riscv,cbqri-rcid:
    $ref: /schemas/types.yaml#/definitions/uint32
    description:
      The maximum number of RCIDs the controller supports. RCIDs are the
      resource-control IDs that allocation operations target.

  riscv,cbqri-mcid:
    $ref: /schemas/types.yaml#/definitions/uint32
    description:
      The maximum number of MCIDs the controller supports. MCIDs are the
      monitoring-counter IDs that usage-monitoring operations target. Present
      on controllers that implement monitoring.

  riscv,cbqri-cache:
    $ref: /schemas/types.yaml#/definitions/phandle
    description:
      Phandle to the cache node whose capacity this controller allocates.
      Applies to capacity controllers that back a CPU cache. The cache level
      and the harts sharing it are taken from that node's cache topology.

required:
  - compatible
  - reg

allOf:
  - if:
      properties:
        compatible:
          contains:
            const: tenstorrent,ascalon-shared-cache-controller
    then:
      required:
        - riscv,cbqri-rcid
        - riscv,cbqri-cache

additionalProperties: false

examples:
  - |
    l2_cache: l2-cache {
        compatible = "cache";
        cache-level = <2>;
        cache-unified;
        cache-size = <0xc00000>;
        cache-sets = <512>;
        cache-block-size = <64>;
    };

    qos-controller@a21a00c0 {
        compatible = "tenstorrent,ascalon-shared-cache-controller",
                     "riscv,cbqri-capacity-controller";
        reg = <0xa21a00c0 0xf40>;
        riscv,cbqri-rcid = <16>;
        riscv,cbqri-cache = <&l2_cache>;
    };

...
```

## arch/riscv/Kconfig.vendor
```kconfig
menu "Vendor extensions"

config RISCV_ISA_VENDOR_EXT
	bool

menu "Andes"
config RISCV_ISA_VENDOR_EXT_ANDES
	bool "Andes vendor extension support"
	select RISCV_ISA_VENDOR_EXT
	default y
	help
	  Say N here if you want to disable all Andes vendor extension
	  support. This will cause any Andes vendor extensions that are
	  requested by hardware probing to be ignored.

	  If you don't know what to do here, say Y.
endmenu

menu "T-Head"
config RISCV_ISA_VENDOR_EXT_THEAD
	bool "T-Head vendor extension support"
	select RISCV_ISA_VENDOR_EXT
	default y
	help
	  Say N here to disable detection of and support for all T-Head vendor
	  extensions. Without this option enabled, T-Head vendor extensions will
	  not be detected at boot and their presence not reported to userspace.

	  If you don't know what to do here, say Y.

config RISCV_ISA_XTHEADVECTOR
	bool "xtheadvector extension support"
	depends on RISCV_ISA_VENDOR_EXT_THEAD
	depends on RISCV_ISA_V
	depends on FPU
	default y
	help
	  Say N here if you want to disable all xtheadvector related procedures
	  in the kernel. This will disable vector for any T-Head board that
	  contains xtheadvector rather than the standard vector.

	  If you don't know what to do here, say Y.

config RISCV_ISA_XUANTIE_SSDTSO
	bool "xuantie ssdtso extension support for dynamic TSO memory ordering"
	depends on RISCV_ISA_VENDOR_EXT_THEAD
	select DYNAMIC_MEMORY_CONSISTENCY_MODEL
	help
	  Adds support to dynamically detect the presence of the XuanTie
	  Ssdtso vendor extension and allows user-space processes to
	  activate/deactivate the TSO memory ordering model at run-time.

	  The Ssdtso specification is not ratified yet, so it is handled as
	  a vendor extension instead of a standard ISA extension.

	  If you don't know what to do here, say Y.
endmenu

endmenu
```

## drivers/resctrl/Kconfig
```kconfig
# SPDX-License-Identifier: GPL-2.0-only

menuconfig RISCV_CBQRI
	bool "RISC-V CBQRI support"
	depends on RISCV && RISCV_ISA_SSQOSID
	help
	  Capacity and Bandwidth QoS Register Interface (CBQRI) support for
	  RISC-V cache QoS resources. CBQRI exposes cache capacity
	  allocation through the resctrl filesystem at /sys/fs/resctrl when
	  RESCTRL_FS is also enabled.

if RISCV_CBQRI

config RISCV_CBQRI_CAPACITY
	bool "RISC-V CBQRI cache capacity-allocation controller"
	default y if OF && RISCV_CBQRI
	help
	  Enable driver for a RISC-V CBQRI capacity controller that
	  governs a CPU cache, matching the "riscv,cbqri-capacity-controller"
	  compatible. The controller's cache phandle gives the cache level and the
	  harts that share it, which the driver registers as a resctrl
	  cache-allocation resource.

	  Say N unless your device tree describes a CBQRI capacity controller.

endif

config RISCV_CBQRI_RESCTRL_FS
	bool
	default y if RISCV_CBQRI && RESCTRL_FS
```
