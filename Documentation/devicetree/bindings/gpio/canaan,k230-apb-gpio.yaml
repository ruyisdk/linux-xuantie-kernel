## arch/riscv/configs/th1520_defconfig
```kconfig
CONFIG_SYSVIPC=y
CONFIG_POSIX_MQUEUE=y
CONFIG_NO_HZ_IDLE=y
CONFIG_HIGH_RES_TIMERS=y
CONFIG_BPF_SYSCALL=y
CONFIG_IKCONFIG=y
CONFIG_IKCONFIG_PROC=y
CONFIG_CGROUPS=y
CONFIG_NAMESPACES=y
CONFIG_USER_NS=y
CONFIG_CHECKPOINT_RESTORE=y
CONFIG_BLK_DEV_INITRD=y
CONFIG_EXPERT=y
CONFIG_ARCH_RENESAS=y
CONFIG_ARCH_THEAD=y
CONFIG_ARCH_XUANTIE=y
CONFIG_SOC_SIFIVE=y
CONFIG_SOC_STARFIVE=y
CONFIG_ARCH_SUNXI=y
CONFIG_ARCH_CANAAN=y
CONFIG_SMP=y
CONFIG_HOTPLUG_CPU=y
CONFIG_PM=y
CONFIG_CPU_IDLE=y
CONFIG_VIRTUALIZATION=y
CONFIG_KVM=y
CONFIG_ACPI=y
CONFIG_MODULES=y
CONFIG_MODULE_UNLOAD=y
CONFIG_BLK_DEV_THROTTLING=y
CONFIG_NET=y
CONFIG_PACKET=y
CONFIG_UNIX=y
CONFIG_INET=y
CONFIG_IP_MULTICAST=y
CONFIG_IP_ADVANCED_ROUTER=y
CONFIG_IP_PNP=y
CONFIG_IP_PNP_DHCP=y
CONFIG_IP_PNP_BOOTP=y
CONFIG_IP_PNP_RARP=y
CONFIG_BRIDGE_NETFILTER=m
CONFIG_NF_CONNTRACK=m
CONFIG_NF_CONNTRACK_FTP=m
CONFIG_NF_CONNTRACK_TFTP=m
CONFIG_NETFILTER_XT_MARK=m
CONFIG_NETFILTER_XT_MATCH_ADDRTYPE=m
CONFIG_NETFILTER_XT_MATCH_CONNTRACK=m
CONFIG_NETFILTER_XT_MATCH_IPVS=m
CONFIG_IP_VS=m
CONFIG_IP_VS_PROTO_TCP=y
CONFIG_IP_VS_PROTO_UDP=y
CONFIG_IP_VS_RR=m
CONFIG_IP_VS_NFCT=y
CONFIG_NF_LOG_ARP=m
CONFIG_NF_LOG_IPV4=m
CONFIG_IP_NF_IPTABLES=m
CONFIG_IP_NF_FILTER=m
CONFIG_IP_NF_TARGET_REJECT=m
CONFIG_IP_NF_NAT=m
CONFIG_IP_NF_TARGET_MASQUERADE=m
CONFIG_IP_NF_TARGET_REDIRECT=m
CONFIG_IP_NF_MANGLE=m
CONFIG_NF_LOG_IPV6=m
CONFIG_IP6_NF_IPTABLES=m
CONFIG_IP6_NF_MATCH_IPV6HEADER=m
CONFIG_IP6_NF_FILTER=m
CONFIG_IP6_NF_TARGET_REJECT=m
CONFIG_IP6_NF_MANGLE=m
CONFIG_BRIDGE=y
CONFIG_BRIDGE_VLAN_FILTERING=y
CONFIG_NET_CLS_CGROUP=m
CONFIG_NETLINK_DIAG=y
CONFIG_NET_9P=y
CONFIG_NET_9P_VIRTIO=y
CONFIG_PCIE_FU740=y
CONFIG_DEVTMPFS=y
CONFIG_DEVTMPFS_MOUNT=y
CONFIG_BLK_DEV_LOOP=y
CONFIG_VIRTIO_BLK=y
CONFIG_BLK_DEV_NVME=m
CONFIG_BLK_DEV_SD=y
CONFIG_MD=y
CONFIG_BLK_DEV_DM=y
CONFIG_BLK_DEV_DM_BUILTIN=y
CONFIG_DM_THIN_PROVISIONING=m
CONFIG_NETDEVICES=y
CONFIG_VIRTIO_NET=y
CONFIG_MACB=y
CONFIG_STMMAC_ETH=y
CONFIG_MICROSEMI_PHY=y
CONFIG_INPUT_MOUSEDEV=y
CONFIG_KEYBOARD_SUN4I_LRADC=m
CONFIG_SERIAL_8250=y
CONFIG_SERIAL_8250_CONSOLE=y
CONFIG_SERIAL_8250_DW=y
CONFIG_SERIAL_OF_PLATFORM=y
CONFIG_SERIAL_SH_SCI=y
CONFIG_VIRTIO_CONSOLE=y
CONFIG_HW_RANDOM=y
CONFIG_HW_RANDOM_VIRTIO=y
CONFIG_I2C_MV64XXX=y
CONFIG_I2C_DESIGNWARE_PLATFORM=y
CONFIG_I2C_CHARDEV=y
CONFIG_SPI=y
CONFIG_SPI_DW_QUAD=y
CONFIG_SPI_DESIGNWARE=y
CONFIG_SPI_DW_MMIO=y
CONFIG_SPI_SPIDEV=y
CONFIG_SPI_SUN6I=y
# CONFIG_PTP_1588_CLOCK is not set
CONFIG_WATCHDOG=y
CONFIG_DW_WATCHDOG=y
CONFIG_WATCHDOG_PRETIMEOUT_GOV=y
CONFIG_WATCHDOG_PRETIMEOUT_GOV_NOOP=y
CONFIG_WATCHDOG_PRETIMEOUT_GOV_PANIC=y
#CONFIG_WATCHDOG_PRETIMEOUT_DEFAULT_GOV_PANIC=y
CONFIG_WATCHDOG_PRETIMEOUT_DEFAULT_GOV_NOOP=y
CONFIG_WATCHDOG_OPEN_TIMEOUT=32
CONFIG_SUNXI_WATCHDOG=y
CONFIG_REGULATOR=y
CONFIG_REGULATOR_FIXED_VOLTAGE=y
CONFIG_DRM=y
CONFIG_DRM_PANEL_SIMPLE=y
CONFIG_DRM_PANEL_JADARD_JD9365DA_H3=y
CONFIG_DRM_VERISILICON=y
CONFIG_BACKLIGHT_CLASS_DEVICE=y
CONFIG_BACKLIGHT_PWM=y
CONFIG_FB=y
CONFIG_FRAMEBUFFER_CONSOLE=y
CONFIG_ARCH_FORCE_MAX_ORDER=15
CONFIG_LOGO=y
CONFIG_USB=y
CONFIG_USB_XHCI_HCD=y
CONFIG_USB_XHCI_PLATFORM=y
CONFIG_USB_OHCI_HCD=y
CONFIG_USB_STORAGE=y
CONFIG_USB_MUSB_SUNXI=m
CONFIG_MMC=y
CONFIG_MMC_SDHCI=y
CONFIG_MMC_SDHCI_PLTFM=y
CONFIG_MMC_SDHCI_OF_DWCMSHC=y
CONFIG_MMC_SUNXI=y
CONFIG_RTC_CLASS=y
CONFIG_RTC_DRV_SUN6I=y
CONFIG_RTC_DRV_XGENE=m
CONFIG_RTC_DRV_XGENE_PRESCALER=y
CONFIG_DMADEVICES=y
CONFIG_DMA_SUN6I=m
CONFIG_DW_AXI_DMAC=y
CONFIG_DMATEST=y
CONFIG_VIRTIO_MMIO=y
CONFIG_SUN8I_DE2_CCU=m
CONFIG_SUN50I_IOMMU=y
CONFIG_RPMSG=y
CONFIG_RPMSG_CHAR=y
CONFIG_RPMSG_CTRL=y
CONFIG_RPMSG_VIRTIO=y
CONFIG_RPMSG_TH1520=y
CONFIG_ARCH_R9A07G043=y
CONFIG_PHY_SUN4I_USB=m
CONFIG_NVMEM_SUNXI_SID=y
CONFIG_EXT4_FS=y
CONFIG_EXT4_FS_POSIX_ACL=y
CONFIG_BTRFS_FS_POSIX_ACL=y
CONFIG_AUTOFS_FS=y
CONFIG_OVERLAY_FS=y
CONFIG_JOLIET=y
CONFIG_ZISOFS=y
CONFIG_MSDOS_FS=y
CONFIG_VFAT_FS=y
CONFIG_TMPFS=y
CONFIG_TMPFS_POSIX_ACL=y
CONFIG_HUGETLBFS=y
CONFIG_NFS_FS=y
CONFIG_NFS_V4=y
CONFIG_NFS_V4_1=y
CONFIG_NFS_V4_2=y
CONFIG_ROOT_NFS=y
CONFIG_9P_FS=y
CONFIG_NLS_CODEPAGE_437=y
CONFIG_NLS_ISO8859_1=y
CONFIG_SECURITY_SELINUX=y
CONFIG_SECURITY_APPARMOR=y
CONFIG_DEFAULT_SECURITY_DAC=y
CONFIG_CRYPTO_USER_API_HASH=y
CONFIG_PRINTK_TIME=y
CONFIG_DEBUG_FS=y
CONFIG_SOFTLOCKUP_DETECTOR=y
CONFIG_DEBUG_ATOMIC_SLEEP=y
# CONFIG_RCU_TRACE is not set
# Enable TEE
CONFIG_TEE=y
CONFIG_OPTEE=y
CONFIG_RCU_TORTURE_TEST=m
CONFIG_LOCK_TORTURE_TEST=m
CONFIG_TORTURE_TEST=m
CONFIG_BLK_DEV_NBD=y
CONFIG_FUSE_FS=y
CONFIG_STRICT_KERNEL_RWX=n
# Enable BPF_JIT & TEST_BPF
CONFIG_BPF_JIT=y
CONFIG_RUNTIME_TESTING_MENU=y
CONFIG_TEST_BPF=m
# TH1520
CONFIG_PINCTRL=y
CONFIG_PINCTRL_TH1520=y
# TH1520 PWM
CONFIG_PWM=y
CONFIG_PWM_THEAD=y
# TH1520 dwmac
CONFIG_DWMAC_THEAD=y
# TH1520 GPIO
CONFIG_GPIO_DWAPB=y
CONFIG_GPIO_PCA953X=y
CONFIG_GPIO_PCA953X_IRQ=y
# TH1520 cpu thermal
CONFIG_CPU_THERMAL=y
CONFIG_THERMAL_EMULATION=y
CONFIG_SENSORS_MR75203=m
CONFIG_SENSORS_PWM_FAN=m
# TH1520 USB
CONFIG_USB_DWC3=m
CONFIG_USB_DWC3_DUAL_ROLE=y
CONFIG_USB_DWC3_THEAD=m
CONFIG_USB_ROLE_SWITCH=m
CONFIG_USB_ONBOARD_HUB=m
CONFIG_USB_GADGET=m
CONFIG_USB_CONFIGFS=y
CONFIG_USB_CONFIGFS_F_FS=y
CONFIG_USB_CONFIGFS_F_ACC=y
CONFIG_USB_ZERO=m
CONFIG_USB_ETH=m
CONFIG_USB_ETH_EEM=y
CONFIG_USB_G_NCM=m
CONFIG_USB_MASS_STORAGE=m
CONFIG_USB_G_SERIAL=m
CONFIG_USB_G_MULTI=m
CONFIG_USB_G_MULTI_CDC=y
CONFIG_TYPEC=m
CONFIG_IIO=y
CONFIG_THEAD_TH1520_ADC=m
# TH1520 CLOCK
CONFIG_CLK_TH1520_FM=y
CONFIG_MTD=y
CONFIG_MTD_TESTS=m
CONFIG_MTD_BLOCK=y
CONFIG_MTD_SLRAM=m
CONFIG_MTD_PHRAM=m
CONFIG_MTD_SPI_NAND=y
CONFIG_MTD_SPI_NOR=y
CONFIG_MTD_UBI=y
# TH1520 MAILBOX
CONFIG_MAILBOX=y
# TH1520 AON_SUBSYS
CONFIG_TH1520_AON_PD=y
# TH1520 CPU DVFS
CONFIG_CPU_FREQ=y
CONFIG_CPU_FREQ_STAT=y
CONFIG_CPU_FREQ_GOV_POWERSAVE=y
CONFIG_CPU_FREQ_GOV_USERSPACE=y
CONFIG_CPU_FREQ_GOV_ONDEMAND=y
CONFIG_CPU_FREQ_GOV_CONSERVATIVE=y
CONFIG_CPU_FREQ_GOV_SCHEDUTIL=y
CONFIG_CPUFREQ_DT=y
CONFIG_RISCV_XUANTIE_TH1520_CPUFREQ=y
# TH1520 PMIC_WDT
CONFIG_TH1520_PMIC_WATCHDOG=y
# TH1520 audio
CONFIG_SOUND=y
CONFIG_SND=y
CONFIG_SND_SIMPLE_CARD=y
CONFIG_SND_USB_AUDIO=m
CONFIG_SND_SOC=y
CONFIG_SND_SOC_XUANTIE=y
# TH1520 i2s
CONFIG_SND_SOC_XUANTIE_TH1520_I2S=y
# CONFIG_SND_SOC_XUANTIE_TH1520_I2S_CH8 is not set
CONFIG_SND_SOC_XUANTIE_TH1520_HDMI_PCM=y
# TH1520 codec
CONFIG_SND_SOC_ES7210=y
CONFIG_SND_SOC_ES8156=y
# TH1520 devfreq thermal
CONFIG_PM_DEVFREQ=y
CONFIG_PM_DEVFREQ_EVENT=y
CONFIG_DEVFREQ_GOV_SIMPLE_ONDEMAND=y
CONFIG_DEVFREQ_GOV_PERFORMANCE=y
CONFIG_DEVFREQ_GOV_POWERSAVE=y
CONFIG_DEVFREQ_GOV_USERSPACE=y
CONFIG_DEVFREQ_GOV_PASSIVE=y
CONFIG_THERMAL=y
CONFIG_THERMAL_STATISTICS=y
CONFIG_THERMAL_GOV_POWER_ALLOCATOR=y
# CONFIG_THERMAL_DEFAULT_GOV_POWER_ALLOCATOR is not set
CONFIG_DEVFREQ_THERMAL=y
CONFIG_ABX500_CORE=y
CONFIG_CRASH_DUMP=y
# CONFIG_BUG is not set
CONFIG_DEBUG_INFO=y
CONFIG_DETECT_HUNG_TASK=y
CONFIG_DMABUF_SELFTESTS=m
CONFIG_DYNAMIC_DEBUG=y
CONFIG_EEPROM_AT24=y
# CONFIG_GCC_PLUGINS is not set
CONFIG_HID_PID=y
CONFIG_IIO_SW_DEVICE=y
CONFIG_JFFS2_FS=y
CONFIG_KEXEC=y
CONFIG_LOCKUP_DETECTOR=y
CONFIG_MAGIC_SYSRQ=y
CONFIG_PERF_EVENTS=y
CONFIG_POWER_SUPPLY=y
CONFIG_PREEMPT=y
CONFIG_REALTEK_PHY=y
CONFIG_TASK_DELAY_ACCT=y
CONFIG_TASK_IO_ACCOUNTING=y
CONFIG_TASKSTATS=y
CONFIG_TASK_XACCT=y
CONFIG_V4L_MEM2MEM_DRIVERS=y
CONFIG_V4L_PLATFORM_DRIVERS=y
CONFIG_SCHED_INFO=y
CONFIG_SCHED_MC=y
# CONFIG_SERIAL_8250_DEPRECATED_OPTIONS is not set
CONFIG_SW_SYNC=y
CONFIG_UBIFS_FS=y
CONFIG_UDMABUF=y
CONFIG_RISCV_ISA_V=y
CONFIG_CRYPTO_AUTHENC=y
CONFIG_CRYPTO_CBC=y
CONFIG_CRYPTO_CHACHA20POLY1305=y
CONFIG_CRYPTO_CTR=y
CONFIG_CRYPTO_CURVE25519=y
CONFIG_CRYPTO_DES=y
CONFIG_CRYPTO_DH=y
CONFIG_CRYPTO_ESSIV=y
CONFIG_CRYPTO_MD5=y
CONFIG_CRYPTO_OFB=y
CONFIG_CRYPTO_SHA3=y
CONFIG_CRYPTO_SHA512=y
CONFIG_CRYPTO_SM3=y
CONFIG_CRYPTO_SM4=y
CONFIG_CRYPTO_USER_API_AEAD=y
# CONFIG_CRYPTO_USER_API_RNG_CAVP is not set
CONFIG_CRYPTO_USER_API_RNG=y
CONFIG_CRYPTO_USER_API_SKCIPHER=y
CONFIG_CRYPTO_USER=y
CONFIG_CRYPTO_XTS=y
# CONFIG_DM_BOW is not set
# CONFIG_DM_CACHE is not set
# CONFIG_DM_CLONE is not set
CONFIG_DM_CRYPT=y
# CONFIG_DM_DEBUG is not set
# CONFIG_DM_DELAY is not set
# CONFIG_DM_DUST is not set
# CONFIG_DM_EBS is not set
# CONFIG_DM_ERA is not set
# CONFIG_DM_FLAKEY is not set
# CONFIG_DM_INIT is not set
# CONFIG_DM_INTEGRITY is not set
# CONFIG_DM_LOG_WRITES is not set
# CONFIG_DM_MIRROR is not set
# CONFIG_DM_MULTIPATH is not set
# CONFIG_DM_RAID is not set
# CONFIG_DM_SNAPSHOT is not set
# CONFIG_DM_SWITCH is not set
# CONFIG_DM_THIN_PROVISIONING is not set
# CONFIG_DM_UEVENT is not set
# CONFIG_DM_UNSTRIPED is not set
CONFIG_DM_USER=y
# CONFIG_DM_VERITY is not set
# CONFIG_DM_WRITECACHE is not set
# CONFIG_DM_ZERO is not set
CONFIG_ENERGY_MODEL=y
CONFIG_GPIOLIB=y
CONFIG_INPUT_EVDEV=y
CONFIG_INPUT_TOUCHSCREEN=y
CONFIG_KEYBOARD_GPIO=y
CONFIG_PNFS_BLOCK=y
# CONFIG_PM_SLEEP is not set
# CONFIG_SUSPEND is not set
CONFIG_INPUT_MISC=y
CONFIG_INPUT_UINPUT=y
CONFIG_SCSI=y
# CONFIG_USB_DWC3_OF_SIMPLE is not set
CONFIG_USB_HIDDEV=y
# CONFIG_USB_NET_AX88179_178A is not set
# CONFIG_USB_NET_AX8817X is not set
# CONFIG_USB_NET_NET1080 is not set
CONFIG_USB_STORAGE_SDDR09=y
CONFIG_USB_STORAGE_SDDR55=y
CONFIG_USB_USBNET=m
CONFIG_USB_VIDEO_CLASS=m
CONFIG_VIDEO_ASPEED=y
```

## drivers/clk/thead/Kconfig
```kconfig
# SPDX-License-Identifier: GPL-2.0

config THEAD_CLK
	bool
	def_bool ARCH_THEAD

config CLK_TH1520_FM
	bool "Thead Th1520 Fullmask Clock Driver"
	depends on ARCH_THEAD
	default n
	help
	    Build the driver for th1520 fullmask Clock Driver
```

## drivers/crypto/canaan/Kconfig
```kconfig
# SPDX-License-Identifier: GPL-2.0
#
# k230 AES-GCM configuration
#
config CRYPTO_DEV_KENDRYTE_CRYP
    tristate "Support for K230 crypto accelerators"
    select CRYPTO_AES
    select CRYPTO_BLKCIPHER
    default ARCH_CANAAN
    help
        This driver interfaces with the hardware crypto
        accelerator for K230.
        Supporting AES-GCM encryption and
        decryption.

config CRYPTO_DEV_KENDRYTE_HASH
    tristate "Support for K230 sha256 accelerators"
    select CRYPTO_HASH
    select CRYPTO_SHA256
    default ARCH_CANAAN
    help
        This driver interfaces with the hardware
        hash accelerator for K230.
        Supporting sha256 hashing
        algo.

config CRYPTO_DEV_KENDRYTE_RSA
    tristate "Support for k230 rsa-2048 accelerator"
    select CRYPTO_SKCIPHER
    default ARCH_CANAAN
    help
        This driver interfaces with the hardware
        rsa accelerator for K230.
        Supporting rsa-1024, rsa-2048, rsa-3072,
        rsa-4096 encryption and decryption algo.
```

## drivers/gpu/drm/canaan/Kconfig
```kconfig
# SPDX-License-Identifier: GPL-2.0-only
config DRM_CANAAN
	bool "DRM Support for Canaan K230 Display Controller"
	depends on OF
	depends on COMMON_CLK
	select DRM
	select DRM_KMS_HELPER
	select DRM_KMS_DMA_HELPER
	select DRM_GEM_DMA_HELPER
	select VIDEOMODE_HELPERS
	default ARCH_CANAAN
	help
	  Choose this option if you have a Canaan K230 soc chipset.
	  This driver provides kernel mode setting and buffer
	  management to userspace. This driver does not provide
	  2D or 3D acceleration; acceleration is performed by other
	  IP found on the SoC.

if DRM_CANAAN

config DRM_CANAAN_DSI
	bool "Canaan K230 MIPI-DSI Controller Support"
	select DRM_MIPI_DSI
	default DRM_CANAAN
	help
	  Choose this option if you have a Canaan K230 soc chipset.
	  This driver provides MIPI-DSI controller for DRM.
	  This driver does not provide 2D or 3D acceleration;
	  acceleration is performed by other
	  IP found on the SoC.

endif
```

## drivers/gpu/vglite/Kconfig
```kconfig
# SPDX-License-Identifier: GPL-2.0-only
config GPU_VGLITE
	tristate "VGLite device driver"
	help
	  Add support for Verisilicon VGLite GPU driver.
	  This driver is for single-thread context
	  use. Make sure to control the GPU in single
	  thread.
```

## drivers/media/platform/canaan/vpu/Kconfig
```kconfig
config VPU_CANAAN
	tristate "Linlon VPU support."
	depends on VIDEO_DEV
	depends on COMMON_CLK && HAS_DMA
	select VIDEO_V4L2_SUBDEV_API
	select VIDEOBUF2_DMA_CONTIG
	select V4L_MEM2MEM_DRIVERS
	select V4L2_FWNODE
	select VIDEOBUF2_DMA_SG
	default y
	help
	  This is a v4l2 driver for Canaan video codec.
	  Canaan video codec is video decoder and encoder hardware unit.
	  It accelerates video decoder and encoder operations, such as h264, hevc,
	  jpeg formats.
	  To compile this driver as a module choose m here.

config VPU_CANAAN_FTRACE
	depends on VPU_CANAAN
	bool "Send kernel space logs to ftrace."
	default n
	help
	  This is a v4l2 driver for Canaan video codec.
	  Canaan video codec is video decoder and encoder hardware unit.
	  It accelerates video decoder and encoder operations, such as h264, hevc,
	  jpeg formats. Send kernel space logs to ftrace.
	  To compile this driver as a module choose m here.

config VPU_CANAAN_PRINT_FILE
	depends on VPU_CANAAN
	bool "Append file and line number to kernel space log messages."
	default y
	help
	  This is a v4l2 driver for Canaan video codec.
	  Canaan video codec is video decoder and encoder hardware unit.
	  It accelerates video decoder and encoder operations, such as h264, hevc,
	  jpeg formats. Append file and line number to kernel space log messages.
	  To compile this driver as a module choose m here.
```

## drivers/misc/canaan/ai2d/Kconfig
```kconfig
config K230_AI2D_DRIVER
		tristate "K230 AI2D driver"
		default	m
		help
		This option enables support for K230
		Say Y for enabling the k230 ai2d driver
		To compile this support as a module, choose M here
		If unsure, say N.
```

## drivers/misc/canaan/gnne/Kconfig
```kconfig
config K230_GNNE_DRIVER
		tristate "K230 GNNE driver"
		default m
		help
		This option enables support for K230
		Say Y for enabling the k230 gnne driver
		To compile this support as a module, choose M here
		If unsure, say N.
```

## drivers/misc/canaan/mmz/Kconfig
```kconfig
config K230_MMZ
	tristate "K230 mem zone driver"
	default	m
	help
		This option enables support for K230
		Say Y for enabling the k230 mmz driver
		To compile this support as a module, choose M here
		If unsure, say N.
```

## drivers/soc/thead/Kconfig
```kconfig
# SPDX-License-Identifier: GPL-2.0-only
menu "Thead SoC drivers"

config LIGHT_REBOOTMODE
	bool "Thead light rebootmode support"
	default y
	help
	 This driver supports check rebootmode feature in Light FM platform

endmenu
```

## sound/soc/canaan/Kconfig
```kconfig
config SND_SOC_CANAAN_K230_INNO
	tristate "ASoC support for CANAAN boards using a inno codec"
	help
	  Say Y or M here if you want to add support for SoC audio on CANAAN K230
	  boards using the INNO codec. This option enables the ASoC audio driver
	  for CANAAN K230 boards, allowing audio playback and recording through
	  the INNO codec. If unsure, select M.

config SND_SOC_CANAAN_K230_AUDIO
	tristate "CANAAN K230 AUDIO interface support"
	help
	  Say Y or M here if you want to enable k230 audio for canaan soc. This
	  option provides the necessary interface support for audio functionalities
	  on CANAAN K230 SoC, enabling audio input and output capabilities. If
	  unsure, select M.
```

## sound/soc/dwc_canaan/Kconfig
```kconfig
config CANAAN_SND_DESIGNWARE_I2S
	tristate "Synopsys I2S Device Driver"
	depends on HAVE_CLK
	select SND_SOC_GENERIC_DMAENGINE_PCM
	help
	  This option enables the Synopsys I2S device driver.
	  The I2S (Inter-IC Sound) bus is used for connecting digital audio devices.
	  Selecting this option will compile the driver as a module or built-in.
	  It depends on the availability of clock support (HAVE_CLK) and selects
	  the generic DMA engine PCM support for audio data transfer.
	  Say Y or M if you have a Synopsys I2S device in your system.

config CANAAN_SND_DESIGNWARE_PCM
	bool "PCM PIO extension for I2S driver"
	depends on CANAAN_SND_DESIGNWARE_I2S
	help
	 Say Y or N if you want to add a custom ALSA extension that registers
	 a PCM and uses PIO to transfer data.
	 This functionality is specially suited for I2S devices that don't have
	 DMA support.
```
