## Documentation/devicetree/bindings/gpio/canaan,k230-apb-gpio.yaml
```yaml
# SPDX-License-Identifier: (GPL-2.0 OR BSD-2-Clause)
%YAML 1.2
---
$id: http://devicetree.org/schemas/gpio/canaan,k230-apb-gpio.yaml#
$schema: http://devicetree.org/meta-schemas/core.yaml#

title: K230 GPIO controller

description: |
  K230 GPIO controllers is based on Synopsys DesignWare GPIO controllers
  with out pinctrl required.

maintainers:
  - huangziyi <huangziyi@canaan-creative.com>

properties:
  $nodename:
    pattern: "^gpio@[0-9a-f]+$"

  compatible:
    const: canaan,k230-apb-gpio

  "#address-cells":
    const: 1

  "#size-cells":
    const: 0

  reg:
    maxItems: 1

patternProperties:
  "^gpio-(port|controller)@[0-9a-f]+$":
    type: object
    properties:
      compatible:
        const: canaan,k230-apb-gpio-port

      reg:
        maxItems: 1

      gpio-controller: true

      '#gpio-cells':
        const: 2

      gpio-line-names:
        const: 32

      ngpios:
        const: 32

      snps,nr-gpios:
        description: The number of GPIO pins exported by the port.
        deprecated: true
        $ref: /schemas/types.yaml#/definitions/uint32
        const: 32

      interrupts:
        description: |
          The interrupts to the parent controller raised when GPIOs generate
          the interrupts. If the controller provides one combined interrupt
          for all GPIOs, specify a single interrupt. If the controller provides
          one interrupt for each GPIO, provide a list of interrupts that
          correspond to each of the GPIO pins.
        const: 32

      interrupt-controller: true

      '#interrupt-cells':
        const: 2

    required:
      - compatible
      - reg
      - gpio-controller
      - '#gpio-cells'

    dependencies:
      interrupt-controller: [ interrupts ]

    additionalProperties: false

additionalProperties: false

required:
  - compatible
  - reg
  - "#address-cells"
  - "#size-cells"

examples:
  - |
    gpio0: gpio@9140b000 {
      compatible = "canaan,k230-apb-gpio";
      reg = <0x0 0x9140b000 0x0 0x1000>;
      #address-cells = <1>;
      #size-cells = <0>;

      gpio0_ports: gpio-port@0 {
        compatible = "canaan,k230-apb-gpio-port";
        reg = <0>;
        gpio-controller;
        #gpio-cells = <2>;
        snps,nr-gpios = <32>;
        interrupt-controller;
        #interrupt-cells = <2>;
        interrupts =
          <32 IRQ_TYPE_EDGE_RISING>,
          <33 IRQ_TYPE_EDGE_RISING>,
          <34 IRQ_TYPE_EDGE_RISING>,
          <35 IRQ_TYPE_EDGE_RISING>,
          <36 IRQ_TYPE_EDGE_RISING>,
          <37 IRQ_TYPE_EDGE_RISING>,
          <38 IRQ_TYPE_EDGE_RISING>,
          <39 IRQ_TYPE_EDGE_RISING>,
          <40 IRQ_TYPE_EDGE_RISING>,
          <41 IRQ_TYPE_EDGE_RISING>,
          <42 IRQ_TYPE_EDGE_RISING>,
          <43 IRQ_TYPE_EDGE_RISING>,
          <44 IRQ_TYPE_EDGE_RISING>,
          <45 IRQ_TYPE_EDGE_RISING>,
          <46 IRQ_TYPE_EDGE_RISING>,
          <47 IRQ_TYPE_EDGE_RISING>,
          <48 IRQ_TYPE_EDGE_RISING>,
          <49 IRQ_TYPE_EDGE_RISING>,
          <50 IRQ_TYPE_EDGE_RISING>,
          <51 IRQ_TYPE_EDGE_RISING>,
          <52 IRQ_TYPE_EDGE_RISING>,
          <53 IRQ_TYPE_EDGE_RISING>,
          <54 IRQ_TYPE_EDGE_RISING>,
          <55 IRQ_TYPE_EDGE_RISING>,
          <56 IRQ_TYPE_EDGE_RISING>,
          <57 IRQ_TYPE_EDGE_RISING>,
          <58 IRQ_TYPE_EDGE_RISING>,
          <59 IRQ_TYPE_EDGE_RISING>,
          <60 IRQ_TYPE_EDGE_RISING>,
          <61 IRQ_TYPE_EDGE_RISING>,
          <62 IRQ_TYPE_EDGE_RISING>,
          <63 IRQ_TYPE_EDGE_RISING>;
      };
    };
...
```

## Documentation/devicetree/bindings/mmc/canaan,k230-dw-mshc.yaml
```yaml
# SPDX-License-Identifier: (GPL-2.0-only OR BSD-2-Clause)
%YAML 1.2
---
$id: http://devicetree.org/schemas/mmc/canaan,k230-dw-mshc.yaml#
$schema: http://devicetree.org/meta-schemas/core.yaml#

title: kendryte Sparx5 Mobile Storage Host Controller

allOf:
  - $ref: mmc-controller.yaml

maintainers:
  - Lars Povlsen <lars.povlsen@microchip.com>

# Everything else is described in the common file
properties:
  compatible:
    const: canaan,k230-dw-mshc

  reg:
    maxItems: 1

  interrupts:
    maxItems: 1

  clocks:
    maxItems: 1
    description:
      Handle to "core" clock for the sdhci controller.

  clock-names:
    items:
      - const: core

  microchip,clock-delay:
    description: Delay clock to card to meet setup time requirements.
      Each step increase by 1.25ns.
    $ref: /schemas/types.yaml#/definitions/uint32
    minimum: 1
    maximum: 15

required:
  - compatible
  - reg
  - interrupts
  - clocks
  - clock-names

unevaluatedProperties: false

examples:
  - |
    sdhci0@91580000 {
            compatible = "canaan,k230-dw-mshc";
            reg = <0x0 0x91580000 0x0 0x1000>;
            interrupts = <142 IRQ_TYPE_LEVEL_HIGH>;
            interrupt-names = "sdhci0irq";
            clocks = <&dummy_sd>,<&dummy_sd>;
            clock-names = "core", "bus";
            max-frequency = <200000000>;
            bus-width = <8>;
            sdhci,auto-cmd12;
            dma-noncoherent;
            status = "disabled";
        };
```

## Documentation/devicetree/bindings/reset/canaan,k230-rst.yaml
```yaml
# SPDX-License-Identifier: (GPL-2.0-only OR BSD-2-Clause)
%YAML 1.2
---
$id: http://devicetree.org/schemas/reset/canaan,k230-sysctl-reset.yaml#
$schema: http://devicetree.org/meta-schemas/core.yaml#

title: Canaan Kendryte k230 Reset Controller

maintainers:
  - Damien Le Moal <dlemoal@kernel.org>

description: |
  Canaan Kendryte k230 reset controller driver which supports the SoC
  system controller supplied reset registers for the various peripherals
  of the SoC. The k230 reset controller node must be defined as a child
  node of the k230 system controller node.

  See also:
  - dt-bindings/reset/k230-rst.h

properties:
  compatible:
    const: canaan,k230-sysctl-reset

  '#reset-cells':
    const: 1

required:
  - '#reset-cells'
  - compatible

additionalProperties: false

examples:
  - |
    #include <dt-bindings/reset/k230-rst.h>
    sysrst: reset-controller {
      compatible = "canaan,k230-sysctl-reset";
      #reset-cells = <4>;
    };
```

## Documentation/devicetree/bindings/sound/canaan,k230-audio-inno.yaml
```yaml
# SPDX-License-Identifier: (GPL-2.0-only OR BSD-2-Clause)

%YAML 1.2
---
$id: "http://devicetree.org/schemas/sound/canaan,k230-audio-inno.yaml#"
$schema: "http://devicetree.org/meta-schemas/core.yaml#"

title: Canaan K230 Audio INNO Device Tree Bindings

maintainers:
- Sun Xiaopeng <sunxiaopeng@canaan-creative.com>

description: |
This document describes the device tree bindings for the audio subsystem
on the Canaan K230 SoC using the INNO codec.

properties:
compatible:
  const: "canaan,k230-audio-inno"
  description: |
    Must be "canaan,k230-audio-inno".

canaan,model:
  $ref: /schemas/types.yaml#/definitions/string
  description: |
    Custom model name for the sound card.

canaan,k230-i2s-controller:
  $ref: /schemas/types.yaml#/definitions/phandle
  description: |
    Phandle to the I2S controller node.

canaan,k230-audio-codec:
  $ref: /schemas/types.yaml#/definitions/phandle
  description: |
    Phandle to the audio codec node.

required:
- compatible
- canaan,k230-i2s-controller
- canaan,k230-audio-codec

additionalProperties: false

examples:
- |
  sound {
      compatible = "canaan,k230-audio-inno";
      canaan,model = "K230_I2S_INNO";
      canaan,k230-i2s-controller = <&i2s>;
      canaan,k230-audio-codec = <&inno_codec>;
  };
```

## Documentation/devicetree/bindings/sound/canaan,k230-audio.yaml
```yaml
# SPDX-License-Identifier: (GPL-2.0-only OR BSD-2-Clause)
%YAML 1.2
---
$id: "http://devicetree.org/schemas/sound/canaan,k230-audio.yaml#"
$schema: "http://devicetree.org/meta-schemas/core.yaml#"

title: Canaan K230 Audio Controller Device Tree Bindings

maintainers:
	- Sun Xiaopeng <sunxiaopeng@canaan-creative.com>

description: |
	This document defines the device tree bindings for the audio controller
	found in the Canaan K230 SoC. The audio controller provides interfaces for
	audio input and output functionalities.

properties:
	compatible:
		enum:
			- canaan,k230-audio
		description: |
			Specifies the compatible string for the Canaan K230 audio controller.

	reg:
		maxItems: 1
		description: |
			Specifies the base physical address and size of the audio controller's
			register area.

	status:
		description: |
			Standard property to indicate the operational status of the device.
			Should be "okay" if the device is enabled.

required:
	- compatible
	- reg

additionalProperties: false

examples:
	- |
		audio: audio@9140f400 {
				compatible = "canaan,k230-audio";
				reg = <0x0 0x9140f400 0x0 0xc00>;
				status = "okay";
		};
```

## Documentation/devicetree/bindings/sound/canaan,k230-inno-codec.yaml
```yaml
# SPDX-License-Identifier: (GPL-2.0-only OR BSD-2-Clause)

%YAML 1.2
---
$id: "http://devicetree.org/schemas/sound/canaan,k230-inno-codec.yaml#"
$schema: "http://devicetree.org/meta-schemas/core.yaml#"

title: Canaan k230 Inno Codec

maintainers:
	- Sun Xiaopeng <sunxiaopeng@canaan-creative.com>

compatible: "canaan,k230-inno-codec"
description: "Inno Codec Device for K230 SoC"

properties:
  status:
    description: "The status of the codec device"
    type: string
    default: "disabled"
    values:
      - "okay"
      - "disabled"

  reg:
    description: "Base address and size of the codec registers"
    type: <address>

  clocks:
    description: "Clocks used by the codec"
    type: list
    items: phandle

  clock-names:
    description: "Names corresponding to each clock"
    type: list
    items: string

examples:
  - |
    inno_codec:inno_codec@0x9140e000 {
      status = "okay";
      compatible = "canaan,k230-inno-codec";
      reg = <0x0 0x9140e000 0x0 0x1000>;
      clocks = <&codec_adc_mclk>, <&codec_dac_mclk>;
      clock-names = "adc", "dac";
    };
```

## Documentation/devicetree/bindings/sound/canaan,k230-pdma.yaml
```yaml
# SPDX-License-Identifier: (GPL-2.0-only OR BSD-2-Clause)
%YAML 1.2
---
$id: "http://devicetree.org/schemas/dma/canaan,k230-pdma.yaml#"
$schema: "http://devicetree.org/meta-schemas/core.yaml#"

title: Canaan K230 PDMA Controller

maintainers:
	- Sun Xiaopeng <sunxiaopeng@canaan-creative.com>

description: |
	The Canaan K230 PDMA controller is a peripheral DMA controller that supports
	multiple channels and request signals.

properties:
	compatible:
		const: canaan,k230-pdma
		description: Must be "canaan,k230-pdma"

	reg:
		maxItems: 1
		description: Base address and size of the PDMA registers.

	interrupts:
		maxItems: 1
		description: Interrupt specifier for the PDMA controller.

	clocks:
		maxItems: 1
		description: Reference to the PDMA controller clock.

	dma-channels:
		description: The number of DMA channels supported by the controller.

	dma-requests:
		description: The number of DMA request signals supported.

	'#dma-cells':
		const: 4
		description: Must be 4. Specifies the number of cells in the DMA specifier.

required:
	- compatible
	- reg
	- interrupts
	- clocks
	- dma-channels
	- dma-requests
	- '#dma-cells'

additionalProperties: false

examples:
	- |
		pdma: pdma@80804000 {
			compatible = "canaan,k230-pdma";
			reg = <0x0 0x80804000 0x0 0x400>;
			interrupts = <203 IRQ_TYPE_LEVEL_HIGH>;
			clocks = <&pdma_aclk_gate>;
			dma-channels = <8>;
			dma-requests = <35>;
			#dma-cells = <4>;
			status = "okay";
		};
```

## Documentation/devicetree/bindings/sound/canaan,snps,designware-i2s.yaml
```yaml
# SPDX-License-Identifier: (GPL-2.0-only OR BSD-2-Clause)

%YAML 1.2
---
$id: "http://devicetree.org/schemas/sound/canaan,designware-i2s.yaml#"
$schema: "http://devicetree.org/meta-schemas/core.yaml#"

title: Canaan DesignWare I2S Controller

maintainers:
	- Sun Xiaopeng <sunxiaopeng@canaan-creative.com>

description: |
	This document describes the device tree bindings for the Canaan DesignWare
	I2S controller found in the K230 SoC. The controller is compliant with the
	Synopsys DesignWare I2S IP core and requires specific properties to function
	correctly.

properties:
	compatible:
		const: "canaan,snps,designware-i2s"
		description: |
			Must be "canaan,snps,designware-i2s" to identify the Canaan-specific
			implementation of the DesignWare I2S controller.

	reg:
		maxItems: 1
		description: |
			Contains the base address and length of the I2S controller register set.

	status:
		enum:
			- "okay"
			- "disabled"
		description: |
			Standard property to enable or disable the device. Must be "okay" to
			activate the I2S controller.

	dmas:
		minItems: 2
		maxItems: 2
		description: |
			Phandles to the DMA channels for transmit and receive. The first item
			is for transmit (TX), and the second is for receive (RX).

	dma-names:
		items:
			- const: "tx"
			- const: "rx"
		description: |
			Names corresponding to the DMA channels listed in the "dmas" property.

	clocks:
		maxItems: 1
		description: |
			Phandle to the clock provided to the I2S controller.

	clock-names:
		items:
			- const: "i2sclk"
		description: |
			Name of the clock listed in the "clocks" property. Must be "i2sclk".

required:
	- compatible
	- reg
	- status
	- dmas
	- dma-names
	- clocks
	- clock-names

additionalProperties: false

examples:
	- |
		i2s: i2s@9140f000 {
				compatible = "canaan,snps,designware-i2s";
				reg = <0x0 0x9140f000 0x0 0x400>;
				status = "okay";
				dmas = <&pdma 1 0xfff 0 0x14>, <&pdma 1 0xfff 0 0x15>;
				dma-names = "tx", "rx";
				clocks = <&audio_dev_clk>;
				clock-names = "i2sclk";
		};
```
